## projects/art_pi2_uf2/Kconfig
```kconfig
mainmenu "RT-Thread Configuration"

config BSP_DIR
    string
    option env="BSP_ROOT"
    default "."

config RTT_DIR
    string
    option env="RTT_ROOT"
    default "rt-thread"

config PKGS_DIR
    string
    option env="PKGS_ROOT"
    default "packages"

source "$RTT_DIR/Kconfig"
source "$PKGS_DIR/Kconfig"
source "$RTT_DIR/../libraries/Kconfig"

config RT_STUDIO_BUILT_IN
    bool
    select ARCH_ARM_CORTEX_M7
    select RT_USING_COMPONENTS_INIT
    default y

menu "Memory XIP Configs"

config BSP_USING_APS256XX_HSPI_PSRAM
    bool "Using highspeed APS256XX HSPI(X16) PSRAM"
    default y

config BSP_USING_W35T51NW_OSPI_FLASH
    bool "Using highspeed W35T51NW OSPI(X8) NorFlash"
    default y

endmenu
```
